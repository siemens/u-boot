// SPDX-License-Identifier: GPL-2.0
/*
 * Copyright (c) Siemens AG, 2023
 *
 * Authors:
 *   Jan Kiszka <jan.kiszka@siemens.com>
 */

#include "k3-am65-iot2050-common-u-boot.dtsi"
#include "k3-am65-iot2050-boot-image.dtsi"

&smbios_system {
	product = "SIMATIC IOT2050 Basic";
};

&smbios_baseboard {
	product = "SIMATIC IOT2050 Basic";
};

&smbios_chassis {
	product = "SIMATIC IOT2050 Basic";
};
