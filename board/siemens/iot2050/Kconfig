## board/siemens/iot2050/Kconfig
```kconfig
# SPDX-License-Identifier: GPL-2.0+
#
# Copyright (c) Siemens AG, 2018-2023
#
# Authors:
#   Le Jin <le.jin@siemens.com>
#   Jan Kiszka <jan.kiszka@siemens.com>

if TARGET_IOT2050_A53

config SYS_BOARD
	default "iot2050"

config SYS_VENDOR
	default "siemens"

config SYS_CONFIG_NAME
	default "iot2050"

config IOT2050_BOOT_SWITCH
	bool "Disable eMMC boot via USER button (Advanced version only)"
	default y

config IOT2050_REQUIRE_DMA_ISOLATION
	bool "Always configure DMA isolation into device tree (Advanced version only)"
	help
	  When enabled, DMA isolation is always enabled for Advanced devices in
	  their device trees. This means that the environment variable
	  'restricted_dma_pool_mb' can only control the size of restricted DMA
	  pool, but it can no longer we used to disable this by setting it to
	  0.

config IOT2050_EMBED_OTPCMD
	bool "Embed OTP programming data"
	help
	  Embed signed OTP programming data 'otpcmd.bin' into the firmware
	  image. This data will be evaluated and executed on first boot of the
	  device.

endif
```

## board/siemens/iot2050/u-boot.its
```
// SPDX-License-Identifier: GPL-2.0+
/*
 * Copyright (c) Siemens AG, 2020
 *
 * Authors:
 *   Jan Kiszka <jan.kiszka@siemens.com>
 */
/dts-v1/;

/ {
	description = "U-Boot for IOT2050";
	#address-cells = <0x1>;

	images {
		u-boot {
			description = "U-Boot";
			type = "standalone";
			arch = "arm64";
			os = "u-boot";
			compression = "none";
			load = <0x80800000>;
			entry = <0x80800000>;
			data = /incbin/("u-boot-nodtb.bin");
		};

		fdt-iot2050-basic {
			description = "iot2050-basic.dtb";
			type = "flat_dt";
			arch = "arm64";
			compression = "none";
			data = /incbin/("arch/arm/dts/iot2050-basic.dtb");
		};

		fdt-iot2050-advanced {
			description = "iot2050-advanced.dtb";
			type = "flat_dt";
			arch = "arm64";
			compression = "none";
			data = /incbin/("arch/arm/dts/iot2050-advanced.dtb");
		};
	};

	configurations {
		default = "conf-iot2050-basic";
	
		conf-iot2050-basic {
			description = "iot2050-basic";
			firmware = "u-boot";
			fdt = "fdt-iot2050-basic";
		};

		conf-iot2050-advanced {
			description = "iot2050-advanced";
			firmware = "u-boot";
			fdt = "fdt-iot2050-advanced";
		};
	};
};
```
